## config/boards/shields/tamaYa/Kconfig.defconfig
```kconfig
if SHIELD_TAMAYA_L

config ZMK_KEYBOARD_NAME
    default "tamaYa_L"

config ZMK_SPLIT
    default y

config ZMK_SPLIT_ROLE_CENTRAL
    default y

endif

if SHIELD_TAMAYA_R

config ZMK_KEYBOARD_NAME
    default "tamaYa_R"

config ZMK_SPLIT
    default y

endif
```

## config/boards/shields/tamaYa/Kconfig.shield
```kconfig
config SHIELD_TAMAYA_R
    def_bool $(shields_list_contains,tamaYa_R)

config SHIELD_TAMAYA_L
    def_bool $(shields_list_contains,tamaya_L)
```

## config/boards/shields/tany/Kconfig.shield
```kconfig
config SHIELD_TANY_R
    def_bool $(shields_list_contains,tany_R)

config SHIELD_TANY_L
    def_bool $(shields_list_contains,tany_L)
```
